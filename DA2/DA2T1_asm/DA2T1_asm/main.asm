;
; DA2T1_asm.asm
;
; Created: 3/9/2016 7:23:32 AM
; Author : Calvin
;

.INCLUDE "M328PDEF.INC"
	SBI		DDRC, 0x00
	LDI		R16, 0x00
	OUT		PORTC, R16
	LDI		R17, 0x01

BEGIN:
	RCALL	SLOW
	EOR		R17, R16
	OUT		PORTC, R17
	RJMP	BEGIN

SLOW:
	LDI		R20, 0x3D
	STS		OCR1AH, R20		;OCR1AH = 3D
	LDI		R20, 0X09
	STS		OCR1AL, R20		;OCR1AH = 09
	LDI		R20, 0X00		
	STS		TCCR1A, R20		;WGM13:0 = 0100 (CTC Mode) and COM1A1:0 (toggle OC1A)
	LDI		R20, 0x0C
	STS		TCCR1B, R20		;prescaler to 4, I/O/256
	
FUNC1:
	IN		R20, TIFR1
	SBRS	R20, OCF1A		;skip next instruction if OFC1A = 1
	RJMP	FUNC1
	LDI		R18, 1<<OCF1A
	OUT		TIFR1, R18		;clear OCF1A
	RET